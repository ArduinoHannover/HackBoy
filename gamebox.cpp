#include "gamebox.h"

gamebox::gamebox() {
}

void gamebox::begin() {
	Serial.begin(115200);
	tft.begin();
	tft.fillScreen(WHITE);
	tft.setTextColor(BLACK);
	tft.setCursor(32,100);
	tft.println("Ardtendo(c)");
	tft.setCursor(32,112);
	tft.println("ardtendo.de");
	pinMode(LEFT_KEY, INPUT_PULLUP);
	pinMode(UP_KEY, INPUT_PULLUP);
	pinMode(RIGHT_KEY, INPUT_PULLUP);
	pinMode(DOWN_KEY, INPUT_PULLUP);
	pinMode(START_KEY, INPUT_PULLUP);
	pinMode(SELECT_KEY, INPUT_PULLUP);
	pinMode(B_KEY, INPUT_PULLUP);
	pinMode(A_KEY, INPUT_PULLUP);
	delay(150);
	uint16_t colors[] = {YELLOW, RED, MAGENTA, GREEN, BLUE};
	#ifdef SIMPLE_SETUP
	tft.setTextSize(2);
	char* gb = "GAME BOX";
	
	for (uint8_t i = 0; i < 20; i++) {
		tft.setCursor(15,50);
		for (uint8_t c = 0; c < 8; c++) {
			if (i - c < 0) break;
			tft.setTextColor(colors[min((i-c)/2, 4)]);
			tft.write(gb[c]);
		}
		delay(50);
	}
	#else
	static const uint8_t logo [21][16] = { 
		{ 0x0,  0x0, 0x30,  0x0,  0x0,  0x0,  0x0,  0x0,  0x0,  0x0,  0x0,  0x0,  0x6,  0x0,  0x0,  0x0},
		{ 0x0,  0x7, 0xfe, 0x1f, 0xc0, 0x7c, 0x1f, 0x87, 0xff, 0x81, 0xff, 0xc0, 0x3f, 0xcf, 0x83, 0xe0},
		{ 0x0, 0x1f, 0xfe, 0x1f, 0xc0, 0x7c, 0x1f, 0x87, 0xff, 0x81, 0xff, 0xe0, 0xff, 0xef, 0x87, 0xc0},
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		{ 0x0, 0x1f, 0xcf, 0x80, 0xfe,  0x7, 0x83, 0xdf, 0xfc,  0xf, 0xfe,  0x0, 0x3c, 0x1f,  0x3, 0xc0}
	};
	uint16_t color;
	uint32_t nextFrame;
	for (int8_t i = 0; i < 50; i++) {
		nextFrame = millis()+40;
		for (uint8_t col = 0; col < 16; col++) {
			uint8_t prev = ((i-1)/2 - col) / 2;
			uint8_t now  = (i/2 - col) / 2;
			if (prev == now && now != 0) continue;
			if (prev  >= 4) continue;
			if (i/2 < col) break;
			color = colors[min(now, 4)];
			for (uint8_t row = 0; row < 21; row++) {
				for (uint8_t b = 7; b < 8; b--) {
					if ((logo[row][col] >> b) & 1) {
						tft.drawPixel(col * 8 + 7 - b, 50 + row, color);
					}
				}
			}
		}
		while (millis() < nextFrame);
	}
	#endif
	delay(1500);
	tft.fillScreen(WHITE);
}

uint8_t gamebox::startMultiplayer() {
	tft.fillScreen(BLACK);
	tft.setTextColor(WHITE);
	tft.setTextSize(3);
	tft.setCursor(38,40);
	tft.print("> <");
	tft.setTextSize(1);
	tft.setCursor(32,64);
	tft.print("Mehrspieler");
	tft.setCursor(12,72);
	tft.print("Auf Gegner warten");
	tft.setTextSize(3);
	uint8_t playerN = 1;
	unsigned long started = millis();
	//while(Serial.available()) Serial.read();
	if (Serial.peek() != 1)
		Serial.write(1);
	while (true) {
		tft.setTextColor((millis()/300)%2 ? WHITE : BLACK);
		tft.setCursor(40,40);
		tft.print(" ?");
		if (Serial.available()) {
			char c = Serial.read();
			switch (c) {
			case 1:
				playerN = 2;
				Serial.write(2);
				break;
			case 2:
				Serial.write(3);
			case 3:
				tft.fillScreen(BLACK);
				return playerN;
			}
		}
		if (started+10000 < millis()) {
			break;
		}
	}
	tft.setTextColor(BLACK);
	tft.setCursor(40,40);
	tft.print(" ?");
	tft.setTextColor(WHITE);
	tft.setCursor(40,40);
	tft.print(" X");
	tft.setTextSize(1);
	tft.setCursor(44,80);
	tft.print("Fehler:");
	tft.setCursor(5,88);
	switch (playerN) {
		case 1:
			tft.print("Kein Gegner gefunden");break;
		case 2:
			tft.print("    Keine Antwort   ");break;
	}
	while (!getStartKey());
	return false;
}

uint8_t gamebox::getMovement() {
	return ((!digitalRead(LEFT_KEY))*LEFT_BIT)|((!digitalRead(UP_KEY))*UP_BIT)|((!digitalRead(RIGHT_KEY))*RIGHT_BIT)|((!digitalRead(DOWN_KEY))*DOWN_BIT);
}

boolean gamebox::getLeftKey() {
	return !digitalRead(LEFT_KEY);
}
boolean gamebox::getUpKey() {
	return !digitalRead(UP_KEY);
}
boolean gamebox::getRightKey() {
	return !digitalRead(RIGHT_KEY);
}
boolean gamebox::getDownKey() {
	return !digitalRead(DOWN_KEY);
}
boolean gamebox::getStartKey() {
	return !digitalRead(START_KEY);
}
boolean gamebox::getSelectKey() {
	return !digitalRead(SELECT_KEY);
}
boolean gamebox::getBKey() {
	return !digitalRead(B_KEY);
}
boolean gamebox::getAKey() {
	return !digitalRead(A_KEY);
}

int16_t gamebox::recvMessage() {
	unsigned long started = millis();
	while (started+1000 > millis()) {
		if (Serial.available()) {
			Serial.write(255);
			return Serial.read();
		}
	}
	return -1;
}

boolean gamebox::sendMessage(byte msg) {
	Serial.write(msg);
	unsigned long sent = millis();
	while (sent+1000 > millis()) {
		if (Serial.available()) {
			if (Serial.read() == 255) return true;
		}
	}
	tft.fillScreen(BLACK);
	tft.setTextColor(WHITE);
	tft.setTextSize(3);
	tft.setCursor(40,40);
	tft.print(">X<");
	tft.setTextSize(1);
	tft.setCursor(6,64);
	tft.print("Verbindung verloren");
	tft.setCursor(10,72);
	tft.print("Gleiches Spiel an?");
	while(!getStartKey());
	return false;
}

gamebox Gamebox = gamebox();
TFT_ILI9163C tft = TFT_ILI9163C(__CS, __DC);
